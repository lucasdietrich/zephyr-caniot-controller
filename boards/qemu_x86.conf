## boards/qemu_x86.conf
```kconfig
# -----------------------------------------------------------------------------

# Application specific

CONFIG_DISCOVERY_SERVER=y
# CONFIG_DISCOVERY_SERVER_LOG_LEVEL=4

CONFIG_HTTP_REQUEST_HEADERS_BUFFER_SIZE=352
CONFIG_HTTP_MAX_CONNECTIONS=3
CONFIG_HTTP_TEST=y
CONFIG_HTTP_TEST_SERVER=y

CONFIG_SYSTEM_MONITORING=y

CONFIG_CANTCP_SERVER=n

CONFIG_CANIOT_CONTROLLER=n

CONFIG_BLE_CONTROLLER=n




# -----------------------------------------------------------------------------

CONFIG_ENTROPY_DEVICE_RANDOM_GENERATOR=n
CONFIG_TEST_RANDOM_GENERATOR=y

# -----------------------------------------------------------------------------

CONFIG_QEMU_ICOUNT=n

# -----------------------------------------------------------------------------

CONFIG_NET_LOG=y
CONFIG_NET_SOCKETS_LOG_LEVEL_DBG=n

# Network application options and configuration for QEMU
CONFIG_NET_CONFIG_SETTINGS=y
CONFIG_NET_CONFIG_NEED_IPV6=y
CONFIG_NET_CONFIG_MY_IPV6_ADDR="2001:db8::1"
CONFIG_NET_CONFIG_PEER_IPV6_ADDR="2001:db8::2"
CONFIG_NET_CONFIG_NEED_IPV4=y
CONFIG_NET_CONFIG_MY_IPV4_ADDR="192.0.2.1"
CONFIG_NET_CONFIG_PEER_IPV4_ADDR="192.0.2.2"

CONFIG_NET_CONFIG_MY_IPV4_GW="192.0.2.2"

CONFIG_NET_CONFIG_AUTO_INIT=y
CONFIG_NET_CONFIG_CLOCK_SNTP_INIT=n

CONFIG_NET_DHCPV4=n

CONFIG_DNS_RESOLVER_MAX_SERVERS=1
CONFIG_DNS_SERVER_IP_ADDRESSES=y
CONFIG_DNS_SERVER1="192.168.10.6"
CONFIG_DNS_RESOLVER_LOG_LEVEL_DBG=n

CONFIG_NET_SOCKETS_DNS_TIMEOUT=5000

CONFIG_NET_STATISTICS=y
CONFIG_NET_STATISTICS_USER_API=y
CONFIG_NET_STATISTICS_IPV4=y
CONFIG_NET_STATISTICS_ICMP=y
CONFIG_NET_STATISTICS_TCP=y
CONFIG_NET_STATISTICS_UDP=y

CONFIG_NET_BUF_DATA_SIZE=512
# default 36
CONFIG_NET_PKT_RX_COUNT=256
CONFIG_NET_PKT_TX_COUNT=256
CONFIG_NET_BUF_RX_COUNT=256
CONFIG_NET_BUF_TX_COUNT=256

# -----------------------------------------------------------------------------

CONFIG_CANIOT_LIB=y
CONFIG_CANIOT_LOG_LEVEL=2
CONFIG_CANIOT_ASSERT=n
CONFIG_CANIOT_MAX_PENDING_QUERIES=6
CONFIG_CANIOT_DRIVERS_API=n
CONFIG_CANIOT_CTRL_DRIVERS_API=y

# -----------------------------------------------------------------------------

# CONFIG_LOG_STRDUP_MAX_STRING=64
# CONFIG_LOG_STRDUP_BUF_COUNT=42
# CONFIG_LOG_BUFFER_SIZE=2048
# CONFIG_LOG_MODE_DEFERRED=n

# enable to immediate while debugging or when having immediate response is needed
# disable to log time sensitive functions (need a bit more RAM for a thread and pools)
CONFIG_LOG_MODE_IMMEDIATE=y
# -----------------------------------------------------------------------------

CONFIG_ASSERT=y

# -----------------------------------------------------------------------------

CONFIG_HEAP_MEM_POOL_SIZE=2048

CONFIG_DISK_DRIVER_RAM=y
CONFIG_DISK_RAM_VOLUME_SIZE=256
CONFIG_DISK_RAM_VOLUME_NAME="RAM"

CONFIG_FS_LOG_LEVEL_INF=y

# -----------------------------------------------------------------------------

CONFIG_SHELL=y

CONFIG_FLASH_SHELL=y

CONFIG_FILE_SYSTEM_SHELL=y

# Net shell(s)
# https://docs.zephyrproject.org/latest/services/shell/index.html#shell-api
# https://docs.zephyrproject.org/latest/connectivity/networking/api/net_shell.html
CONFIG_NET_SHELL=y
# CONFIG_NET_ROUTE=y
```

## src/ble/Kconfig
```kconfig
menuconfig APP_BLE_INTERFACE
        bool "Bluetooth"
        default y
        depends on BT
        help
                Enable BLE interface with coprocessor

if APP_BLE_INTERFACE

config APP_XIAOMI_MAX_DEVICES
	int "Maximum XIAOMI devices supported"
	default 13
	depends on BT_OBSERVER
	help
		Maximum XIAOMI devices supported.

config APP_ACTIVE_SCAN_DURATION
	int "Active scan duration (in seconds)"
	default 30
	help
		Active scan duration (in seconds)

config APP_PASSIVE_SCAN_DURATION
	int "Passive scan minimum required duration (in seconds)"
	default 3570
	help
		Passive scan minimum required duration (in seconds)

endif
```

## src/can/Kconfig
```kconfig
#
# Copyright (c) 2022 Lucas Dietrich <ld.adecy@gmail.com>
#
# SPDX-License-Identifier: Apache-2.0
#

menuconfig APP_CAN_INTERFACE
        bool "CAN interface"
        default y
        help
                Enable CAN interface
```

## src/cantcp/Kconfig
```kconfig
#
# Copyright (c) 2022 Lucas Dietrich <ld.adecy@gmail.com>
#
# SPDX-License-Identifier: Apache-2.0
#

menuconfig APP_DFU
        bool "Enable DFU"
        default n
        depends on BOOTLOADER_MCUBOOT && IMG_MANAGER
        help
                Enable DFU features
```

## src/cloud/Kconfig
```kconfig
#
# Copyright (c) 2022 Lucas Dietrich <ld.adecy@gmail.com>
#
# SPDX-License-Identifier: Apache-2.0
#

menuconfig APP_CLOUD
        bool "Enable cloud"
        default y
        select APP_CREDENTIALS_MANAGER
        help
                Enable cloud features (AWS, Azure, GCP, etc.)

if APP_CLOUD

rsource "./platforms/aws/Kconfig"

menu "Application"

config APP_CLOUD_TELEMETRY_INTERVAL
		int "Push interval in seconds"
		default 60
		help
				Interval in seconds to push data to the cloud.

endmenu

endif
```

## src/cloud/platforms/aws/Kconfig
```kconfig
#
# Copyright (c) 2022 Lucas Dietrich <ld.adecy@gmail.com>
#
# SPDX-License-Identifier: Apache-2.0
#

menuconfig APP_AWS
        bool "Enable AWS"
        depends on APP_CLOUD
		depends on APP_CREDENTIALS_MANAGER
		select MQTT_LIB
		select MQTT_LIB_TLS
        help
                Select AWS as the cloud platform.

if APP_AWS

config APP_AWS_ENDPOINT
	string "AWS MQTT endpoint"
	help
		Endpoint (hostname) of the AWS MQTT broker.
		Make sure your region supports AWS Device Advisor for DQP

config APP_AWS_PORT
        int "AWS MQTT port"
        default 8883
        help
                Port of the AWS MQTT broker.

config APP_AWS_THING_NAME
	string "AWS Thing name"
	default "myThingName"
	help
		Set the AWS Thing name created on IoT Console

config APP_AWS_DQP_SUBSCRIBE_TOPIC
	string "AWS MQTT subscribe topic"
	default "myThingName/downlink"
	help
		MQTT topic the client should subscribe to in the context of
		the AWS Device Qualification Program

config APP_AWS_DQP_PUBLISH_TOPIC
	string "AWS MQTT publish topic"
	default "myThingName/data"
	help
		MQTT topic the client should publish to  in the context of
		the AWS Device Qualification Program

config APP_AWS_X509_DER_ONLY
        bool "Force use of DER certificates only"
        default y
        help
                Force use of der certificates only, this decrease mbedTLS
                heap usage.


# use choice for QOS
config APP_AWS_QOS
        int "AWS MQTT QoS"
        default 1
        range 0 2
        help
                Quality of Service to use for publishing and subscribing to AWS MQTT broker.
		Note only QoS 0 is supported for AWS DQP

endif
```

## src/creds/Kconfig
```kconfig
#
# Copyright (c) 2022 Lucas Dietrich <ld.adecy@gmail.com>
#
# SPDX-License-Identifier: Apache-2.0
#

menuconfig APP_CREDENTIALS_MANAGER
        bool "Enable credentials manager"
        default y
        help
                Enable credentials manager features (certificates/key manager)

if APP_CREDENTIALS_MANAGER

config APP_CREDS_HARDCODED
	bool "Enable credentials hardcoded in FLASH"
	default y
	help
		No support for dynamic credentials yet.
                Reserved for development.


choice APP_CREDS_MANAGEMENT
	prompt "Choose how certificates should be managed"
	default APP_CREDS_NONE

config APP_CREDS_NONE
	bool "No dynamic certificates management"
	help
		No dynamic certificates management.

config APP_CREDS_FLASH
	bool "Credentials should be stored in flash"
    depends on FLASH
	depends on FLASH_HAS_DRIVER_ENABLED
	depends on BOARD_NUCLEO_F429ZI
	help
		Enable FLASH support for credentials

config APP_CREDS_FS
	bool "Credentials should be stored in a filesystem"
    depends on FILE_SYSTEM
	help
		Enable filesystem support for credentials

endchoice

endif
```

## src/dfu/Kconfig
```kconfig
#
# Copyright (c) 2022 Lucas Dietrich <ld.adecy@gmail.com>
#
# SPDX-License-Identifier: Apache-2.0
#

menuconfig APP_CANTCP_SERVER
        bool "Enable CANTCP server (DEPRECATED)"
        default n
        help
                Enable CANTCP server thread (for CAN over TCP)
```

## src/discovery_server/Kconfig
```kconfig
#
# Copyright (c) 2022 Lucas Dietrich <ld.adecy@gmail.com>
#
# SPDX-License-Identifier: Apache-2.0
#

menuconfig APP_DISCOVERY_SERVER
	bool "Enable discovery server"
        default y
	help
	        Enable UDP discovery server on port 5000

if APP_DISCOVERY_SERVER

config APP_DISCOVERY_SERVER_PORT
        int "UDP discovery server port"
        default 5000
        range 1 65535
        help
                UDP discovery server port

config APP_DISCOVERY_SERVER_SEARCH_STRING
        string "UDP discovery server search string"
        default "Search caniot-controller"
        help
                UDP discovery server search string

config APP_DISCOVERY_SERVER_THREAD_STACK_SIZE
        int "UDP discovery server thread stack size"
        default 1024
        range 512 4096
        help
                UDP discovery server thread stack size

config APP_DISCOVERY_SERVER_LOG_LEVEL
        int "UDP discovery server log level"
        default 2
        range 0 4
        depends on APP_DISCOVERY_SERVER
        help
                NONE(0) ERR(1) WRN (2) INF(3) DBG(4)

endif
```

## src/fs/Kconfig
```kconfig
menu "File System"

config APP_FS_ASYNC_OPERATIONS
        bool "Enable asynchronous file operations"
        default n
        help
                Improve files access performance using asynchronous operations

if APP_FS_ASYNC_OPERATIONS

config APP_FS_ASYNC_READ
        bool "Enable asynchronous file read"
        default y
        help
                Improve files read access performance using asynchronous read operations

config APP_FS_ASYNC_WRITE
        bool "Enable asynchronous file write"
        default n
        help
                Improve files write access performance using asynchronous write operations

endif # APP_FS_ASYNC_OPERATIONS

endmenu # File System
```

## src/ha/Kconfig
```kconfig
#
# Copyright (c) 2022 Lucas Dietrich <ld.adecy@gmail.com>
#
# SPDX-License-Identifier: Apache-2.0
#

menuconfig APP_HA
        bool "Enable Home Automation support"
        default y
        help
                Enable Home Automation module features

if APP_HA

config APP_HA_EMULATED_DEVICES
        bool "Enable HA Emulated Devices"
        default n
        depends on !APP_CLOUD
        help
                Enable HA Emulated Devices.

# TODO: Not fully implemented yet
config APP_HA_STATS
        bool "Enable HA Stats"
        default y
        help
                Enable HA Stats.

# TODO: Not fully implemented yet
config APP_HA_DEVICE_STATS
        bool "Enable HA Stats for individual devices"
        default y
        depends on APP_HA_STATS
        help
                Enable HA Device Stats.

config APP_HA_DEVICES_MAX_COUNT
        int "Maximum number of HA devices"
        default 128 if QEMU_TARGET || APP_HA_EMULATED_DEVICES
        default 32
        range 1 256
        help
                Maximum number of HA devices.

config APP_HA_EVENTS_MAX_COUNT
        int "Maximum number of HA events"
        default 256 if QEMU_TARGET || APP_HA_EMULATED_DEVICES
        default 64
        range 1 512
        help
                Maximum number of HA devices.

config APP_HA_SUBSCRIPTIONS_MAX_COUNT
        int "Maximum number of HA subscriptions"
        default 8
        range 1 32
        help
                Maximum number of HA devices.

config APP_HA_CANIOT_CONTROLLER
        bool "Enable CANIOT controller (DEPRECATED)"
        default n
        depends on APP_CAN_INTERFACE || APP_HA_EMULATED_DEVICES
        depends on CANIOT_LIB
        help
                Enable CANIOT controller redirection for CAN messages

endif
```

## src/http_server/Kconfig
```kconfig
#
# Copyright (c) 2022 Lucas Dietrich <ld.adecy@gmail.com>
#
# SPDX-License-Identifier: Apache-2.0
#

menuconfig APP_HTTP_SERVER
	bool "Enable HTTP server"
        default y
	help
	        Enable HTTP server features (webserver, REST API, prometheus, etc.)

if APP_HTTP_SERVER

config APP_HTTP_THREAD_STACK_SIZE
        int "HTTP thread stack size"
        default 4096
        range 2048 16384
        help
                Size of the stack used by the HTTP thread

config APP_HTTP_SERVER_NONSECURE
        bool "Enable non secure HTTP server"
        default y

config APP_HTTP_SERVER_SECURE
        bool "Enable secure HTTPS server"
        depends on APP_CREDENTIALS_MANAGER
        default y

config APP_HTTP_SERVER_VERIFY_CLIENT
        bool "Verify client certificate"
        depends on APP_HTTP_SERVER_SECURE
        default n

config APP_HTTP_MAX_SESSIONS
        int "Maximum number of HTTP sessions"
        default 5
        range 0 8
        help
                Maximum number of HTTP sessions supported by the HTTP server

config APP_HTTP_SESSION_TIMEOUT
        int "HTTP session timeout in seconds"
        default 30
        range 0 600
        help
                Time in seconds after which an HTTP session is closed if no
                activity is detected

config APP_HTTP_BUFFER_SIZE
        int "HTTP buffer size"
        default 8192
        range 0 65536
        help
                Size of the buffer used to store HTTP request and response

config APP_HTTP_HEADERS_BUFFER_SIZE
        int "HTTP buffer size dedicated for headers"
        default 1024
        range 0 65536
        help
                Size of the buffer used to store HTTP headers

config APP_HTTP_REQUEST_HEADERS_BUFFER_SIZE
        int "HTTP buffer size dedicated for request headers values"
        default 352
        range 0 2048
        help
                Size of the buffer used to store HTTP request headers values

config APP_ROUTE_MAX_DEPTH
        int "Maximum depth of the routes tree"
        default 8
        range 1 10
        help
                Maximum depth of the route tree
                
config APP_HTTP_TEST
        bool "Enable HTTP test functions"
        default n
        help
                Enable HTTP test for all request, responses

config APP_HTTP_TEST_SERVER
        bool "Enable HTTP test server"
        default n
        help
                Enable test server and corresponding resources and routes

config APP_HTTP_URL_MAX_LENGTH
        int "Maximum length of an HTTP URL"
        default 128
        range 32 256
        help
                Maximum length of an HTTP URL

menu "HTTP files server"

config APP_FILES_SERVER_MOUNT_POINT
        string "Default mount point for file upload"
        default "/RAM:" if QEMU_TARGET
        default "/SD:" if BOARD_NUCLEO_F429ZI
        help
                Default mount point for file upload (HTTP file server)

config APP_FILE_ACCESS_HISTORY
        bool "Enable file access history"
        default n
        help
                Enable file access history

config APP_FILE_ACCESS_HISTORY_SIZE
        int "Maximum number of file access history entries"
        depends on APP_FILE_ACCESS_HISTORY
        default 10
        range 1 20
        help
                Maximum number of file access history entries

endmenu

endif
```

## src/lua/Kconfig
```kconfig
#
# Copyright (c) 2022 Lucas Dietrich <ld.adecy@gmail.com>
#
# SPDX-License-Identifier: Apache-2.0
#

menu "LUA configuration"

if LUA

config APP_LUA_FS_SCRIPTS_DIR
        string "Directory for Lua scripts"
        default "/RAM:/lua" if QEMU_TARGET
        default "/SD:/lua" if BOARD_NUCLEO_F429ZI
        help
                Location of Lua scripts on the FS.

config APP_LUA_FS_DEFAULT_SCRIPTS
        bool "Populate the filesystem with default Lua file"
        depends on QEMU_TARGET
        default n
        help
                Populate the filesystem with embedded Lua files
                for testing in QEMU

config APP_LUA_AUTORUN_SCRIPTS
        bool "Automatically run embedded Lua scripts"
        depends on APP_LUA_FS_DEFAULT_SCRIPTS
        default n
        help
                Populate the filesystem with autorun Lua file 
                for testing

endif

endmenu
```
