## src/mbedtls_config/Kconfig
```kconfig
#
# Copyright (c) 2022 Lucas Dietrich <ld.adecy@gmail.com>
#
# SPDX-License-Identifier: Apache-2.0
#

menu "mbedTLS configuration"

if MBEDTLS

config APP_MBEDTLS_CUSTOM_HEAP_SIZE
        int "mbedTLS heap size"
        default 65536
        range 0 65536
        help
                Set mbedTLS heap size in bytes

config APP_MBEDTLS_CUSTOM_HEAP_CCM
        bool "Place mbedTLS in CCM"
        default y
        help
                Place mbedTLS in Core Coupled Memory (CCM)

endif

endmenu
```

## zephyr/Kconfig
```kconfig
# SPDX-License-Identifier: Apache-2.0

mainmenu "caniot-controller"

# Your application configuration options go here

# Sources Kconfig.zephyr in the Zephyr root directory.
#
# Note: All 'source' statements work relative to the Zephyr root directory (due
# to the $srctree environment variable being set to $ZEPHYR_BASE). If you want
# to 'source' relative to the current Kconfig file instead, use 'rsource' (or a
# path relative to the Zephyr root).

config CONTROLLER_DISCOVERY
	bool "Enable discovery server"
        default y
	help
	        Enable UDP discovery server on port 5000

config CONTROLLER_DISCOVERY_LOG_LEVEL
        int "UDP discovery server log level"
        default 2
        range 0 4
        depends on CONTROLLER_DISCOVERY
        help
                NONE(0) ERR(1) WRN (2) INF(3) DBG(4)

config CONTROLLER_HTTP_SERVER_NONSECURE
        bool "Allow non secure HTTP server"
        default y

config CONTROLLER_MAX_HTTP_CONNECTIONS
        int "Maximum number of HTTP connections"
        default 3
        range 0 5
        help
                Maximum number of HTTP connections supported by the HTTP server

# artificaly enable HAL_CRC drivers from STM32CUBE
# read : https://github.com/zephyrproject-rtos/zephyr/issues/37543
config MY_STM32_HAL
default y
bool
select USE_STM32_HAL_CRC

source "Kconfig.zephyr"
```

## zephyr/dts/bindings/st,stm32-crc.yaml
```yaml
# https://docs.zephyrproject.org/latest/guides/dts/bindings.html

# A high level description of the device the binding applies to:
description: |
   Bindings for CRC peripheral of STM32

compatible: "st,stm32-crc"

properties:
  reg:
    type: array
    description: CRC peripheral MMIO register space
    required: true
  label:
    type: string
    description: human-readable name
    required: false
```
